## CMakeLists.txt
```
#-------------------------------------------------------------------------------
# Zephyr Cerebri Application
#
# Copyright (c) 2023 CogniPilot Foundation
# SPDX-License-Identifier: Apache-2.0

cmake_minimum_required(VERSION 3.13.1)

set(MODULE_EXT_ROOT ${CMAKE_CURRENT_SOURCE_DIR})

find_package(Zephyr REQUIRED HINTS $ENV{ZEPHYR_BASE})

project(zenoh_test LANGUAGES C)

target_compile_options(app PRIVATE -Wall -Wextra -Werror -Wno-unused-parameter -Wno-type-limits)

target_link_libraries(app PRIVATE zenoh-pico)

set(SOURCE_FILES
  src/z_sub.c
  )

message(STATUS "${SOURCE_FILES}")

target_sources(app PRIVATE ${SOURCE_FILES})
```

## Kconfig
```
# Copyright (c) 2021 Nordic Semiconductor ASA
# SPDX-License-Identifier: Apache-2.0
#
# This file is the application Kconfig entry point. All application Kconfig
# options can be defined here or included via other application Kconfig files.
# You can browse these options using the west targets menuconfig (terminal) or
# guiconfig (GUI).
mainmenu "CogniPilot - Cerebri - Zenoh Test"
source "Kconfig.zephyr"

module = CEREBRI
module-str = CEREBRI
source "subsys/logging/Kconfig.template.log_config"
```

## west.yml
```
# Copyright (c) 2023 CogniPilot Foundation
# SPDX-License-Identifier: Apache-2.0

manifest:

  group-filter:
    - +optional

  self:
    west-commands: scripts/west-commands.yml

  remotes:
    - name: zephyrproject-rtos
      url-base: https://github.com/zephyrproject-rtos
    - name: cognipilot
      url-base: https://github.com/CogniPilot
    - name: zenoh
      url-base: https://github.com/eclipse-zenoh

  projects:
    - name: zephyr
      remote: cognipilot
      west-commands: scripts/west-commands.yml
      revision: a7a080bf2e5175a1a3e26ac876a92d5c8268cf2f # qdec-tested 11/10/23
      import:
        - name-allowlist:
          - nanopb
          - mbedtls
          - hal_nxp
          - cmsis
          - ubxlib
    - name: zenoh-pico
      remote: cognipilot
      revision: 43d2b4c46350363585bae4033271fe3f545c9049 # main 11/11/23
      path: modules/lib/zenoh_pico
```

## prj.conf
```kconfig
CONFIG_ZENOH_PICO=y
CONFIG_NO_OPTIMIZATIONS=y
CONFIG_NATIVE_UART_0_ON_OWN_PTY=y
CONFIG_NATIVE_UART_0_ON_STDINOUT=n

# Kernel options
CONFIG_MAIN_STACK_SIZE=5120
CONFIG_HEAP_MEM_POOL_SIZE=150000
CONFIG_ENTROPY_GENERATOR=y
CONFIG_TEST_RANDOM_GENERATOR=y
CONFIG_INIT_STACKS=y

# Generic library options
#CONFIG_NEWLIB_LIBC=y
CONFIG_POSIX_API=n
CONFIG_MAX_PTHREAD_COUNT=4

# Generic networking options
CONFIG_NETWORKING=y
CONFIG_NET_L2_ETHERNET=y
CONFIG_ETH_NATIVE_POSIX=y
#CONFIG_ETH_NATIVE_POSIX_RANDOM_MAC=y

CONFIG_NET_IPV4=y
CONFIG_NET_IPV6=y
CONFIG_NET_TCP=y
CONFIG_NET_ARP=y
CONFIG_NET_UDP=y
CONFIG_NET_DHCPV4=n
CONFIG_NET_SHELL=y
CONFIG_NET_MGMT=y
CONFIG_NET_MGMT_EVENT=y
CONFIG_NET_MGMT_EVENT_INFO=y
CONFIG_NET_MGMT_EVENT_MONITOR=y
CONFIG_DNS_RESOLVER=y

# Sockets
CONFIG_NET_SOCKETS=y
CONFIG_NET_SOCKETS_POSIX_NAMES=y
CONFIG_NET_SOCKETS_POLL_MAX=4

# Network driver config
CONFIG_TEST_RANDOM_GENERATOR=y

# Network buffers
CONFIG_NET_PKT_RX_COUNT=16
CONFIG_NET_PKT_TX_COUNT=16
CONFIG_NET_BUF_RX_COUNT=80
CONFIG_NET_BUF_TX_COUNT=80
CONFIG_NET_CONTEXT_NET_PKT_POOL=y

# Network address config
CONFIG_NET_CONFIG_INIT_TIMEOUT=3
CONFIG_NET_CONFIG_SETTINGS=y
CONFIG_NET_CONFIG_NEED_IPV4=y
CONFIG_NET_IPV4_IGMP=y
CONFIG_NET_CONFIG_NEED_IPV6=y
CONFIG_NET_IPV6_MLD=y
CONFIG_NET_CONFIG_MY_IPV4_ADDR="192.0.2.1"
CONFIG_NET_CONFIG_MY_IPV4_NETMASK="255.255.255.0"
CONFIG_NET_CONFIG_MY_IPV4_GW="192.0.2.2"
#CONFIG_NET_CONFIG_PEER_IPV4_ADDR="192.168.10.10"
CONFIG_NET_CONFIG_MY_IPV6_ADDR="2001:db8::2"
CONFIG_NET_CONFIG_PEER_IPV6_ADDR="2001:db8::1"

# IP address options
CONFIG_NET_IF_UNICAST_IPV6_ADDR_COUNT=3
CONFIG_NET_IF_MCAST_IPV6_ADDR_COUNT=4
CONFIG_NET_MAX_CONTEXTS=10

# Logging
#CONFIG_NET_LOG=y
CONFIG_LOG=y
CONFIG_NET_STATISTICS=y
CONFIG_PRINTK=y
```

## src/z_sub.c
```c
//
// Copyright (c) 2022 ZettaScale Technology
//
// This program and the accompanying materials are made available under the
// terms of the Eclipse Public License 2.0 which is available at
// http://www.eclipse.org/legal/epl-2.0, or the Apache License, Version 2.0
// which is available at https://www.apache.org/licenses/LICENSE-2.0.
//
// SPDX-License-Identifier: EPL-2.0 OR Apache-2.0
//
// Contributors:
//   ZettaScale Zenoh Team, <zenoh@zettascale.tech>

#include <stdio.h>
#include <stdlib.h>
#include <zenoh-pico.h>
#include <zephyr/logging/log.h>
#include <zephyr/shell/shell.h>

#define KEYEXPR "demo/example/**"

LOG_MODULE_REGISTER(main, CONFIG_CEREBRI_LOG_LEVEL);

K_THREAD_STACK_DEFINE(zenoh_work_q_stack_area, 1000000);

struct k_work_q g_zenoh_work_q;

void zenoh_workqueues_entry_point(void)
{
    k_work_queue_init(&g_zenoh_work_q);
    struct k_work_queue_config zenoh_work_q_cfg = {
        .name = "zenoh_work_q",
        .no_yield = true
    };
    k_work_queue_start(
        &g_zenoh_work_q,
        zenoh_work_q_stack_area,
        K_THREAD_STACK_SIZEOF(zenoh_work_q_stack_area),
        4,
        &zenoh_work_q_cfg);
};

struct shell_work_context {
    struct k_work work;
    char connect[64];
    char mode[10];
} g_ctx;

static void data_handler(const z_sample_t *sample, void *arg) {
    z_owned_str_t keystr = z_keyexpr_to_string(sample->keyexpr);
    LOG_WRN(" >> [Subscriber handler] Received ('%s': '%.*s')\n", z_loan(keystr), (int)sample->payload.len,
           sample->payload.start);
    z_drop(z_move(keystr));
}

void zenoh_work_handler(struct k_work* item) {
    struct shell_work_context * ctx = CONTAINER_OF(
            item, struct shell_work_context, work);

    LOG_WRN("mode: %s", ctx->mode);
    LOG_WRN("connect: %s", ctx->connect);

    // Initialize Zenoh Session and other parameters
    z_owned_config_t config = z_config_default();
    zp_config_insert(z_loan(config), Z_CONFIG_MODE_KEY, z_string_make(ctx->mode));
    if (strcmp(ctx->connect, "") != 0) {
        zp_config_insert(z_loan(config), Z_CONFIG_CONNECT_KEY, z_string_make(ctx->connect));
    }

    // Open Zenoh session
    LOG_WRN("Opening Zenoh Session...");
    z_owned_session_t s = z_open(z_move(config));
    if (!z_check(s)) {
        LOG_WRN("Unable to open session!\n");
	return;
    }
    LOG_WRN("OK\n");

    // Start the receive and the session lease loop for zenoh-pico
    zp_start_read_task(z_loan(s), NULL);
    zp_start_lease_task(z_loan(s), NULL);

    LOG_WRN("Declaring Subscriber on %s", KEYEXPR);
    z_owned_closure_sample_t callback = z_closure(data_handler);
    //z_owned_subscriber_t sub = z_declare_subscriber(z_loan(s), z_keyexpr(KEYEXPR), z_move(callback), NULL);
    z_owned_pull_subscriber_t sub = z_declare_pull_subscriber(z_loan(s), z_keyexpr(KEYEXPR), z_move(callback), NULL);

    if (!z_check(sub)) {
        LOG_WRN("Unable to declare subscriber.\n");
	return;
    }
    LOG_WRN("OK!\n");

    while (1) {
        k_msleep(1000);
        LOG_WRN("Pulling data from %s", KEYEXPR);
        z_subscriber_pull(z_loan(sub));
    }

    //LOG_WRN("Closing Zenoh Session...");
    //z_undeclare_subscriber(z_move(sub));

    // Stop the receive and the session lease loop for zenoh-pico
    //zp_stop_read_task(z_loan(s));
    //zp_stop_lease_task(z_loan(s));

    //z_close(z_move(s));
    //LOG_WRN("OK!\n");
    return;
}

int zenoh_shell_handler(const struct shell * sh, size_t argc, char ** argv)
{
    k_work_init(&g_ctx.work, zenoh_work_handler);
    strcpy(g_ctx.mode, argv[1]);
    strcpy(g_ctx.connect, argv[2]);
    k_work_submit_to_queue(&g_zenoh_work_q, &g_ctx.work);
    return 0;
}

K_THREAD_DEFINE(zenoh_workqueue, 1024,
    zenoh_workqueues_entry_point, NULL, NULL, NULL,
    4, 0, 0);

SHELL_CMD_ARG_REGISTER(zenoh, NULL, "connect zenoh", zenoh_shell_handler, 3, 0);

// vi: ts=4 sw=4 et
```
